## meta-my-layer/meta-wic/wic/imx8mp-custom.wks
```
# imx8mp-custom.wks
# U-Boot env raw partition + boot + rootfs + persist + securedata + databackup

part --source rawcopy --sourceparams="file=uboot.env" --ondisk mmcblk0 --fstype=none --label uboot-env --align 4 --size 4

part /boot --source bootimg --ondisk mmcblk0 --fstype=vfat --label boot --active --align 4 --size 128

part / --source rootfs --ondisk mmcblk0 --fstype=ext4 --label rootfsA --align 4 --size 2048
part --source rootfs --ondisk mmcblk0 --fstype=ext4 --label rootfsB --align 4 --size 2048

part /data --source generic --ondisk mmcblk0 --fstype=ext4 --label persist --align 4 --size 256

part --source generic --ondisk mmcblk0 --fstype=ext4 --label securedata --align 4 --size 512

part /backup --source generic --ondisk mmcblk0 --fstype=ext4 --label databackup --align 4 --size 256
```

## meta-rpi-rega/meta-key/conf/layer.conf
```bitbake
# We have a conf and classes directory, add to BBPATH
BBPATH .= ":${LAYERDIR}"

# This should match your layer name
BBFILES += "${LAYERDIR}/recipes-*/*/*.bb \
            ${LAYERDIR}/recipes-*/*/*.bbappend"

# Name of the layer
LAYERNAME = "key"

# Compatible with these Yocto core layers
LAYERSERIES_COMPAT_key = "scarthgap"

# Optional priority
LAYERDEPENDS_key = ""

# License for the layer
# (can be empty if closed)
```
