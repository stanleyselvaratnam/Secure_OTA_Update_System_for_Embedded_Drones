## build-imx8mp-evk/conf/local.conf
```bitbake
# my-config
INHERIT += "rm_work"
PACKAGE_CLASSES ?= "package_ipk"
INIT_MANAGER = "systemd"
IMAGE_FSTYPES += "ext4"
EXTRA_IMAGE_FEATURES = "debug-tweaks ssh-server-openssh"
IMAGE_INSTALL:append = " openssh-sftp-server vim"
ACCEPT_FSL_EULA = "1"

# Pas de Mender ici, kernel + dtb natifs pour imx8mp-evk QEMU
KERNEL_DEVICETREE = "imx8mp-evk.dtb"

IMAGE_CLASSES += "qemuboot"
SERIAL_CONSOLE = "115200 ttyAMA0"
KERNEL_SERIAL_CONSOLE = "console=ttyAMA0,115200n8"

MACHINE ??= "imx8mp-lpddr4-evk"
DISTRO ??= "poky"
BBMULTICONFIG ?= ""
```

## build-imx8mp/conf/bblayers.conf
```bitbake
BBLAYERS ?= " \
    /workdir/meta-freescale \
    /workdir/meta-freescale-3rdparty \
    /workdir/meta-mender-community/meta-mender-nxp \
    /workdir/meta-mender/meta-mender-core \
    /workdir/meta-openembedded/meta-networking \
    /workdir/meta-openembedded/meta-oe \
    /workdir/meta-openembedded/meta-python \
    /workdir/meta-toradex-bsp-common \
    /workdir/meta-toradex-distro \
    /workdir/meta-toradex-nxp \
    /workdir/poky/meta \
    /workdir/poky/meta-poky \
    /workdir/poky/meta-yocto-bsp"
BBPATH ?= "${TOPDIR}"
BBFILES ??= ""
```

## build-imx8mp/conf/local.conf
```bitbake
# my-config

INHERIT += "rm_work"
PACKAGE_CLASSES ?= "package_ipk"
INIT_MANAGER = "systemd"
IMAGE_FSTYPES += "ext4"
EXTRA_IMAGE_FEATURES = "debug-tweaks ssh-server-openssh"
IMAGE_INSTALL:append = " openssh-sftp-server vim"
ACCEPT_FSL_EULA = "1"

# Pas de Mender ici, kernel + dtb natifs pour imx8mp-evk QEMU
KERNEL_DEVICETREE = "imx8mp-evk.dtb"


# IMAGE_CLASSES += "image_type_mender_tezi"
# IMAGE_FSTYPES:append = " mender_tezi"
# IMAGE_FSTYPES:remove = " teziimg"

IMAGE_FSTYPES += "wic"
# WKS_FILE = "custom-imx8mp-layout.wks"
# WIC_CREATE_EXTRA_ARGS = "-e core-image-minimal -f ${WKS_FILE}"

# * ================================================================
# * Mender configuration (meta-mender-core)
# * ================================================================

INHERIT += "mender-full"

# Name of the Mender artifact
MENDER_ARTIFACT_NAME = "release-test"

# Mender server URL and tenant token
# MENDER_SERVER_URL = "https://eu.hosted.mender.io"
# MENDER_SERVER_URL = ""
# MENDER_TENANT_TOKEN = "AVi5j0YkJYNeYRamqwzY2r9WRz3sJo5nbGDGaE0uXtQ"

# Device type
MENDER_DEVICE_TYPE = "imx8mp-verdin"

# Storage device and partition layout
MENDER_STORAGE_DEVICE = "/dev/mmcblk0"
MENDER_STORAGE_TOTAL_SIZE_MB = "4096"
MENDER_BOOT_PART_SIZE_MB = "100"
MENDER_DATA_PART_SIZE_MB = "128"

# # ! Enable automatic U-Boot configuration for partitions
# MENDER_UBOOT_AUTO_CONFIGURE = "1"

# # Polling intervals (empty = default)
# # MENDER_UPDATE_POLL_INTERVAL_SECONDS = ""
# # MENDER_INVENTORY_POLL_INTERVAL_SECONDS = ""
# # MENDER_RETRY_POLL_INTERVAL_SECONDS = ""


# IMAGE_INSTALL:append = " mender-artifact-info"
IMAGE_BOOT_FILES:remove = "boot.scr"

# UBOOT_CONFIG ??= "sd"
# UBOOT_ENV ?= "u-boot-initial-env"

MACHINE ??= "verdin-imx8mp"
DISTRO ??= "tdx-xwayland"
BBMULTICONFIG ?= ""
```

## build-rpi4-encrypted/conf/bblayers.conf
```bitbake
BBLAYERS ?= " \
    /workdir/bitbake-variable-substitution \
    /workdir/meta-custom/meta-hellocustom \
    /workdir/meta-custom/meta-key \
    /workdir/meta-mender-kernel \
    /workdir/meta-mender/meta-mender-core \
    /workdir/meta-my-layer/meta-connectivity \
    /workdir/meta-my-layer/meta-kernel \
    /workdir/meta-openembedded/meta-networking \
    /workdir/meta-openembedded/meta-oe \
    /workdir/meta-openembedded/meta-python \
    /workdir/meta-raspberrypi \
    /workdir/poky/meta \
    /workdir/poky/meta-poky \
    /workdir/poky/meta-yocto-bsp"
BBPATH ?= "${TOPDIR}"
BBFILES ??= ""
```

## build-rpi4-encrypted/conf/local.conf
```bitbake
# my-config
INHERIT += "mender-full rm_work"

# Désactiver le déploiement du kernel Mender (inutile sans U-Boot)
MENDER_FEATURES_DISABLE:append = " mender-kernel"
# MENDER_FEATURES_ENABLE = "mender-image mender-systemd mender-uboot"

IMAGE_FSTYPES = "sdimg"
INIT_MANAGER = "systemd"
PACKAGE_CLASSES ?= "package_ipk"
IMAGE_INSTALL:append = " htop vim ca-certificates"

EXTRA_IMAGE_FEATURES ?= "ssh-server-openssh"
IMAGE_INSTALL:append = " ssh-keys"

INHERIT += "extrausers"
EXTRA_USERS_PARAMS = "usermod -p '$(openssl passwd -1 password123)' root;"

KERNEL_DEVICETREE = "broadcom/bcm2711-rpi-4-b.dtb"

ENABLE_UART = "1"
RPI_EXTRA_CONFIG += "dtoverlay=disable-bt"

DISTRO_FEATURES:append = " wifi"
LICENSE_FLAGS_ACCEPTED += "synaptics-killswitch"

# Mender configuration
MENDER_ARTIFACT_NAME = "release-2"
MENDER_DEVICE_TYPE = "raspberrypi4-64"
MENDER_STORAGE_DEVICE = "/dev/mmcblk0"
MENDER_STORAGE_TOTAL_SIZE_MB = "4096"
MENDER_BOOT_PART_SIZE_MB = "256"

MACHINE ??= "raspberrypi4-64"
DISTRO ??= "poky"
BBMULTICONFIG ?= ""
```

## build-rpi4/conf/bblayers.conf
```bitbake
BBLAYERS ?= " \
    /workdir/meta-community/meta-mender-raspberrypi \
    /workdir/meta-custom/meta-hellocustom \
    /workdir/meta-custom/meta-key \
    /workdir/meta-lts-mixins \
    /workdir/meta-mender/meta-mender-core \
    /workdir/meta-my-layer/meta-local \
    /workdir/meta-my-layer/meta-myapps \
    /workdir/meta-openembedded/meta-networking \
    /workdir/meta-openembedded/meta-oe \
    /workdir/meta-openembedded/meta-python \
    /workdir/meta-raspberrypi \
    /workdir/poky/meta \
    /workdir/poky/meta-poky \
    /workdir/poky/meta-yocto-bsp"
BBPATH ?= "${TOPDIR}"
BBFILES ??= ""
```

## build-rpi4/conf/local.conf
```bitbake
# my-config

# TODO : test the rollback, partition the kernel, double authentification
# * ================================================================
# * Local configuration for building core-image-minimal with Mender
# * ================================================================

# Inherit the full Mender integration layer
INHERIT += "mender-full"
# This really saves a lot of disk space!
INHERIT += "rm_work"
# * ================================================================
# * Package management and image features
# * ================================================================

# Use IPK as package format
PACKAGE_CLASSES ?= "package_ipk"

# Extra image features: debugging tools and SSH server
EXTRA_IMAGE_FEATURES ?= "debug-tweaks ssh-server-openssh"

# Packages to include in the image
IMAGE_INSTALL:append = " htop vim ca-certificates helloworld hellocustom"

# * ================================================================
# * Bootloader configuration
# * ================================================================

# U-Boot bootloader files to include in image
# ! UBOOT_MACHINE = "qemu_arm64_defconfig"
UBOOT_MACHINE = "raspberrypi4_64_defconfig"

IMAGE_BOOT_FILES = "u-boot.bin"

# Init system to use
INIT_MANAGER = "systemd"

# # Kernel et DTB
# KERNEL_DEVICETREE = "qemu.dtb"

# UBOOT_CONFIGURE_ARGS:append = " --disable-efi"

# # Install files in /boot pour U-Boot
# IMAGE_INSTALL:append = " kernel-image kernel-devicetree"

# # Disable EFI-related packages if any
# # IMAGE_INSTALL:remove = "efi-utils"

# * ================================================================
# * ENABLE UART
# * ================================================================

ENABLE_UART = "1"

# * ================================================================
# * Image types
# * ================================================================

# Build SD card image
IMAGE_FSTYPES += "sdimg"

# * ================================================================
# * Partition with WKS (meta-wic)
# * ================================================================

# ! WIC image configuration
# WKS_FILE = "custom-qemuarm64.wks.in"
# IMAGE_FSTYPES += "wic wic.bz2"

# * ================================================================
# * Mender configuration (meta-mender-core)
# * ================================================================

# Name of the Mender artifact
MENDER_ARTIFACT_NAME = "release-7"

# Mender server URL and tenant token
MENDER_SERVER_URL = "https://eu.hosted.mender.io"
MENDER_TENANT_TOKEN = "AVi5j0YkJYNeYRamqwzY2r9WRz3sJo5nbGDGaE0uXtQ"

# Device type
# ! MENDER_DEVICE_TYPE = "qemuarm64"
MENDER_DEVICE_TYPE = "raspberrypi4-64"

# Storage device and partition layout
# ! MENDER_STORAGE_DEVICE = "/dev/vda"
MENDER_STORAGE_DEVICE = "/dev/mmcblk0"
MENDER_STORAGE_TOTAL_SIZE_MB = "4096"
MENDER_BOOT_PART_SIZE_MB = "16"
MENDER_DATA_PART_SIZE_MB = "128"

# ! Enable automatic U-Boot configuration for partitions
MENDER_UBOOT_AUTO_CONFIGURE = "0"

# Polling intervals (empty = default)
MENDER_UPDATE_POLL_INTERVAL_SECONDS = ""
MENDER_INVENTORY_POLL_INTERVAL_SECONDS = ""
MENDER_RETRY_POLL_INTERVAL_SECONDS = ""

# --- MENDER SIGNING / VERIFY CONFIGURATION ---

# Clé publique installée par mender-keys.bb
IMAGE_INSTALL:append = " mender-keys mender-keys-rotation"

# Clé privée utilisée pour signer les artifacts (chemin absolu)
MENDER_ARTIFACT_SIGNING_KEY = "${TOPDIR}/../mender-keys/private.key"

# Clé publique utilisée pour vérifier les artifacts pendant le build
# MENDER_ARTIFACT_VERIFY_KEY  = "${TOPDIR}/../mender-keys/public.key"


IMAGE_INSTALL:append = " mender-artifact-info"
# ! ================================================================
# ! Test Rollback (meta-rollback)
# ! ================================================================

# ! Only to test the rollback
# ! IMAGE_INSTALL:append = " rollback-test"

# ? ================================================================
# ? Build performance tuning
# ? ================================================================

# Limit the number of parallel tasks to avoid memory issues
BB_NUMBER_THREADS = "10"
PARALLEL_MAKE = "-j 10"

# ? ================================================================
# ? Experimental / commented options
# ? ================================================================

# Uncomment to include Mender packages (if using RPM or testing)
# IMAGE_INSTALL:append = " mender-client mender-auth mender-update"

# BBMASK examples (to exclude certain recipes)
# BBMASK += "recipes-mender/mender-client/mender-client_3.5.3.bb"
# BBMASK += "recipes-mender/mender-client/mender-client_git.bb"
# Force specific Mender version or provider
# PREFERRED_VERSION_mender-client = "5.0.2"
# PREFERRED_VERSION_mender = "5.0.2"
# PREFERRED_PROVIDER_mender = "mender"

# Debug prefix map removal
# DEBUG_PREFIX_MAP:remove = "-fcanon-prefix-map"

# Kernel device tree configuration
# KERNEL_DEVICETREE = "qemu.dtb"

# Bootloader and kernel preferences
# IMAGE_INSTALL:remove = "grub"
# UBOOT_MACHINE = "qemu_arm64_defconfig"
# IMAGE_CLASSES = ""
# PREFERRED_PROVIDER_virtual/bootloader = "u-boot"
# PREFERRED_PROVIDER_virtual/kernel = "linux-yocto"

# Emulator / RTC tools
# IMAGE_INSTALL:append = " rtc-tools"

MACHINE ??= "raspberrypi4-64"
DISTRO ??= "poky"
BBMULTICONFIG ?= ""
```

## meta-my-layer/meta-connectivity/conf/layer.conf
```bitbake
# meta-connectivityconfiguration

BBPATH .= ":${LAYERDIR}"

LCONF_VERSION = "7"

# Compatibilité avec la série Yocto scarthgap
LAYERSERIES_COMPAT_meta-connectivity = "scarthgap kirkstone poky"

# Déclaration de la collection
BBFILE_COLLECTIONS += "meta-connectivity"
BBFILE_PATTERN_meta-connectivity= "^${LAYERDIR}/"
BBFILE_PRIORITY_meta-connectivity = "9"

# Recherche des recipes et bbappends dans ce layer
BBFILES += "${LAYERDIR}/recipes-*/*/*.bb \
            ${LAYERDIR}/recipes-*/*/*.bbappend"

# Pour que Yocto trouve les fichiers de patch ou conf associés
FILESEXTRAPATHS:prepend := "${LAYERDIR}/recipes-kernel/linux-firmware-rpidistro/files:"
```

## meta-my-layer/meta-crypto/conf/layer.conf
```bitbake
# Declare this layer
BBPATH .= ":${LAYERDIR}"

BBFILES += "${LAYERDIR}/recipes-*/*/*.bb \
            ${LAYERDIR}/recipes-*/*/*.bbappend"

BBFILE_COLLECTIONS += "meta-crypto"
BBFILE_PATTERN_meta-crypto = "^${LAYERDIR}/"
BBFILE_PRIORITY_meta-crypto = "10"

LAYERSERIES_COMPAT_meta-crypto = "scarthgap"
LAYERDEPENDS_meta-crypto = "core mender"
```

## meta-my-layer/meta-example/conf/layer.conf
```bitbake
# We have a conf and classes directory, add to BBPATH
BBPATH .= ":${LAYERDIR}"

# We have recipes-* directories, add to BBFILES
BBFILES += "${LAYERDIR}/recipes-*/*/*.bb \
            ${LAYERDIR}/recipes-*/*/*.bbappend"

BBFILE_COLLECTIONS += "meta-example"
BBFILE_PATTERN_meta-example = "^${LAYERDIR}/"
BBFILE_PRIORITY_meta-example = "6"

LAYERVERSION_meta-example = "1"
LAYERSERIES_COMPAT_meta-example = "kirkstone dunfell nanbield scarthgap"
```

## meta-my-layer/meta-imx-firmware/conf/layer.conf
```bitbake
# meta-imx-firmware configuration

# We have a conf and classes directory, add to BBPATH
BBPATH .= ":${LAYERDIR}"

# This layer is compatible with Yocto releases
LCONF_VERSION = "7"

# Compatibility with the Yocto release
LAYERSERIES_COMPAT_meta-imx-firmware = "scarthgap kirkstone poky"

# Declaration of collection
BBFILE_COLLECTIONS += "meta-imx-firmware"
BBFILE_PATTERN_meta-imx-firmware= "^${LAYERDIR}/"
BBFILE_PRIORITY_meta-imx-firmware = "9"

# Add recipes-bsp to BBFILES so BitBake trouve nos recettes
BBFILES += "${LAYERDIR}/recipes-*/*/*.bb \
            ${LAYERDIR}/recipes-*/*/*.bbappend"
```

## meta-my-layer/meta-kernel/conf/layer.conf
```bitbake
# meta-kernel/conf/layer.conf

BBFILE_COLLECTIONS += "meta-kernel"
BBFILE_PATTERN_meta-kernel = "^${LAYERDIR}/"
BBFILE_PRIORITY_meta-kernel = "6"

BBPATH .= ":${LAYERDIR}"

BBFILES += "${LAYERDIR}/recipes-*/*/*.bb \
            ${LAYERDIR}/recipes-*/*/*.bbappend"

# Dépendances sur Mender
LAYERDEPENDS_meta-kernel = "core mender mender-kernel"

LAYERSERIES_COMPAT_meta-kernel = "scarthgap"
```

## meta-my-layer/meta-mender-imx/conf/layer.conf
```bitbake
# meta-kernel-custom/conf/layer.conf

BBFILES += "${LAYERDIR}/recipes-*/*/*.bb \
            ${LAYERDIR}/recipes-*/*/*.bbappend"

# Nom de la collection de recettes pour ce layer
BBFILE_COLLECTIONS += "meta-mender-imx"

# Où trouver les recettes pour ce layer
BBFILE_PATTERN_meta-mender-imx:= "^${LAYERDIR}/"

# Priorité du layer (plus haute priorité écrase les autres)
BBFILE_PRIORITY_meta-mender-imx := "99"

LAYER_CONF_VERSION = "7"

# Liste les versions Yocto compatibles (par exemple "zeus", "hardknott", etc.)
LAYERSERIES_COMPAT_meta-mender-imx = "scarthgap"
```

## meta-my-layer/meta-rollback/conf/layer.conf
```bitbake
# meta-rollback/conf/layer.conf
LCONF_VERSION = "7"
BBPATH .= ":${LAYERDIR}"

BBFILES += "${LAYERDIR}/recipes-*/*/*.bb \
             ${LAYERDIR}/recipes-*/*/*.bbappend"

BBFILE_COLLECTIONS += "rollback"
BBFILE_PATTERN_rollback := "^${LAYERDIR}/"
BBFILE_PRIORITY_rollback = "7"

LAYERSERIES_COMPAT_rollback = "scarthgap"
```

## meta-my-layer/meta-wic/conf/layer.conf
```bitbake
# We have a conf and classes directory, add to BBPATH
BBPATH .= ":${LAYERDIR}"
BBFILES += "${LAYERDIR}/recipes-*/*/*.bb ${LAYERDIR}/recipes-*/*/*.bbappend"

# Layer priority and compatibility
BBFILE_COLLECTIONS += "meta-wic"
BBFILE_PATTERN_meta-wic := "^${LAYERDIR}/"
BBFILE_PRIORITY_meta-wic = "6"

LAYERVERSION_meta-wic = "1"
LAYERSERIES_COMPAT_meta-wic = "scarthgap kirkstone"
```

## meta-my-layer/meta-wic/wic/custom-genericarm64.wks
```
part /boot --source bootimg-partition --ondisk vda --fstype=vfat --label boot --active --size 64
part / --ondisk vda --fstype=ext4 --label rootfsA --size 256
part / --ondisk vda --fstype=ext4 --label rootfsB --size 256
part /data --ondisk vda --fstype=ext4 --label data --size 64
```

## meta-my-layer/meta-wic/wic/custom-qemuarm64.wks
```
# core-image-minimal-qemuarm64.wks
# Partition table Mender pour QEMU ARM64

# Partition Boot (U-Boot)
part /boot --source bootimg-partition --ondisk vda --fstype=vfat --label boot --active --size 16

# Rootfs A (active)
part / --source rootfs --ondisk vda --fstype=ext4 --label rootfs1 --size 1945

# Rootfs B (inactive)
part / --source rootfs --ondisk vda --fstype=ext4 --label rootfs2 --size 1945

# Data partition pour Mender
part /data --ondisk vda --fstype=ext4 --label data --size 128
```
